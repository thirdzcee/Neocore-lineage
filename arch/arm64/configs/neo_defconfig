## arch/arm64/configs/neo_defconfig
```kconfig
include lineageos_h990_defconfig
#neocore config
CONFIG_LOCALVERSION=".NeOcOrE"
CONFIG_IOSCHED_TEST=n
CONFIG_SCSI_UFS_TEST=n
CONFIG_INPUT_EVBUG=n
CONFIG_MSM_RDBG=n
CONFIG_MMC_TEST=n
CONFIG_MMC_BLOCK_TEST=n
CONFIG_TCP_CONG_ADVANCED=y
CONFIG_TCP_CONG_WESTWOOD=y
CONFIG_DEFAULT_CUBIC=n
CONFIG_DEFAULT_WESTWOOD=y
CONFIG_DEFAULT_TCP_CONG="westwood"
CONFIG_TCP_CONG_BIC=n
CONFIG_TCP_CONG_HTCP=n
CONFIG_ARM64_ERRATUM_826319=n
CONFIG_ARM64_ERRATUM_827319=n
CONFIG_ARM64_ERRATUM_824069=n
CONFIG_ARM64_ERRATUM_819472=n
CONFIG_ARM64_ERRATUM_832075=n
CONFIG_ARM64_ERRATUM_845719=n
CONFIG_CPU_FREQ_GOV_POWERSAVE=n
CONFIG_CPU_FREQ_GOV_ONDEMAND=n
CONFIG_CPU_FREQ_GOV_USERSPACE=n
CONFIG_CPU_FREQ_GOV_CONSERVATIVE=n
CONFIG_CPU_FREQ_GOV_SCHEDUTIL=y
CONFIG_HZ_250=n
CONFIG_HZ_300=y
CONFIG_HZ=300
CONFIG_DTS_EAGLE=y
CONFIG_BOEFFLA_WL_BLOCKER=y
CONFIG_FB_MSM_MDSS_KCAL_CTRL=y
CONFIG_THERMAL_MONITOR_SIMPLE=y
CONFIG_LGE_PM_WEAK_BATT_PACK=y
CONFIG_LGE_PM_FG_ACFA=y
```
